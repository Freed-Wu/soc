/include/ "system-conf.dtsi"
/ {
};

/* SD */
&sdhci1 {
  disable-wp;
  no-1-8-v;
};

/* USB */
&dwc3_0 {
  dr_mode = "host";
};

&amba_pl {
    #address-cells = <2>;
    #size-cells = <2>;
    axi_tangxi: axi_tangxi@80000000 {
        compatible = "xlnx,axi-tangxi";
        interrupt-names = "axitangxi_irq";
        interrupt-parent = <&gic>;
        interrupts = <0 89 4>;
        reg = <0x0 0x80000000 0x0 0x10000>;
    };
};
